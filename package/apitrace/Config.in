## package/apitrace/Config.in
```kconfig
comment "apitrace needs a toolchain w/ C++"
	depends on !BR2_INSTALL_LIBSTDCPP

config BR2_PACKAGE_APITRACE
	bool "apitrace"
	depends on BR2_INSTALL_LIBSTDCPP
	select BR2_PACKAGE_XLIB_LIBX11 if BR2_PACKAGE_XORG7
	select BR2_PACKAGE_LIBPNG
	help
	  Trace and replay OpenGL and OpenGL ES APIs calls to/from a
	  file. You may install apitrace GUI from your distribution to
	  inspect generated traces.

	  http://apitrace.github.io/
```
